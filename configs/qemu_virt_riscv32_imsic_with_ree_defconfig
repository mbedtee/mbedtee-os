## configs/qemu_virt_riscv32_imsic_with_ree_defconfig
```kconfig
CONFIG_RISCV=y
CONFIG_REE=y
CONFIG_MMU_SV32=y
CONFIG_QEMU_VIRT_RISCV32_IMSIC=y
CONFIG_NR_CPUS=4
CONFIG_PRINTK=y
CONFIG_BACKTRACE=y
CONFIG_INTC=y
CONFIG_RISCV_IMSIC=y
CONFIG_UART=y
CONFIG_UART_16550=y
CONFIG_RISCV_TIMER=y
CONFIG_RPC=y
CONFIG_GLOBALPLATFORM=y
CONFIG_FATFS=y
CONFIG_RAMFS=y
CONFIG_REEFS=y
CONFIG_TMPFS=y
CONFIG_DEBUGFS=y
CONFIG_USER=y
CONFIG_IPC_SHM=y
CONFIG_IPC_MSGQ=y
CONFIG_USER_BACKTRACE=y
CONFIG_EPOLL=y
CONFIG_ASLR=y
CONFIG_TEE_API=y
CONFIG_AUTH_TA=y
CONFIG_SIMPLE_SHELL=y
CONFIG_MBEDTEST=y
```

## configs/qemu_virt_riscv64_defconfig
```kconfig
# CONFIG_ARM is not set
# CONFIG_MIPS is not set
CONFIG_RISCV=y


#
# RISCV Architecture
#
# CONFIG_RISCV32 is not set
CONFIG_RISCV64=y
CONFIG_RISCV_S_MODE=y
CONFIG_RISCV_TIMER=y
CONFIG_MMU=y
CONFIG_MMU_SV39=y
CONFIG_64BIT=y
CONFIG_CFLAGS="-mabi=lp64d -march=rv64imafdc_zicsr_zifencei_zicbom -mstrict-align -mcmodel=medany -mno-riscv-attribute"
CONFIG_PIC_CFLAGS="-fPIC"
CONFIG_VA_BITS=39
# end of RISCV Architecture

#
# Platform Configure
#
CONFIG_QEMU_VIRT_RISCV64=y
# CONFIG_QEMU_SIFIVE_U_RISCV64 is not set
# end of Platform Configure

#
# General Setup
#
CONFIG_NR_CPUS=4
CONFIG_PRINTK=y
CONFIG_TRACE_LEVEL=3
CONFIG_VMALLOC=y
CONFIG_STACK_PROTECTOR=y
CONFIG_BACKTRACE=y
CONFIG_EMBEDDED_DTB=y
CONFIG_ELF_LOADER=y
CONFIG_OS_ADDR=0xffffffe000000000
# end of General Setup

#
# Device Drivers
#
CONFIG_DRIVER_BASE=y
CONFIG_RNG=y
CONFIG_PRNG=y
CONFIG_INTC=y
# CONFIG_INTEL_I8259 is not set
CONFIG_RISCV_PLIC=y
CONFIG_UART=y
CONFIG_UART_16550=y
# CONFIG_UART_PL011 is not set
# CONFIG_UART_SIFIVE is not set
CONFIG_RPC=y
CONFIG_RPC_YIELD=y
CONFIG_GLOBALPLATFORM=y
# end of Device Drivers

#
# File Systems
#
CONFIG_FS=y
CONFIG_DEVFS=y
CONFIG_FATFS=y
CONFIG_RAMFS=y
CONFIG_TMPFS=y
CONFIG_DEBUGFS=y
# end of File Systems

#
# Libraries
#
CONFIG_KERN_NEWLIB=y
CONFIG_FDT_LIB=y
CONFIG_USER_MBEDTLS=y
# CONFIG_USER_MBEDTLS_PSA is not set
# CONFIG_USER_MBEDTLS_X509 is not set
# CONFIG_USER_MBEDTLS_SSL is not set
CONFIG_KERNEL_MBEDTLS=y
# end of Libraries

#
# UserSpace
#
CONFIG_USER=y
CONFIG_SYSCALL=y
CONFIG_USER_PTHREAD=y
CONFIG_SIGNAL=y
CONFIG_IPC_SHM=y
CONFIG_IPC_MSGQ=y
CONFIG_USER_BACKTRACE=y
CONFIG_EPOLL=y
CONFIG_ASLR=y
CONFIG_TEE_API=y
# end of UserSpace

#
# Applications
#
CONFIG_AUTH_TA=y
CONFIG_SIMPLE_SHELL=y
CONFIG_USER_SHELL=y
# CONFIG_KERN_SHELL is not set
CONFIG_MBEDTEST=y
# end of Applications
```

## configs/qemu_xlnx_versal_virt_defconfig
```kconfig
CONFIG_ARM=y
CONFIG_AARCH64=y
CONFIG_ARM_GICV3=y
CONFIG_REE=y
CONFIG_64BIT=y
CONFIG_MMU=y
CONFIG_CFLAGS="-march=armv8-a"
CONFIG_PIC_CFLAGS="-fPIC"
CONFIG_VA_BITS=39
CONFIG_QEMU_XLNX_VERSAL_VIRT=y
CONFIG_NR_CPUS=2
CONFIG_PRINTK=y
CONFIG_TRACE_LEVEL=3
CONFIG_VMALLOC=y
CONFIG_STACK_PROTECTOR=y
CONFIG_BACKTRACE=y
CONFIG_EMBEDDED_DTB=y
CONFIG_OS_ADDR=0xFFFFFFC000000000
CONFIG_KMALLOC_SLAB=y
CONFIG_ELF_LOADER=y
CONFIG_IPC_PIPE=y
CONFIG_IPC_SEM=y
CONFIG_IPC_EVENTFD=y
CONFIG_IPC_SHM=y
CONFIG_IPC_MSGQ=y
CONFIG_DRIVER_BASE=y
CONFIG_RNG=y
CONFIG_PRNG=y
CONFIG_UART=y
CONFIG_UART_POLL=y
CONFIG_UART_PL011=y
CONFIG_TIMER=y
CONFIG_ARMV8_GENERIC_TIMER=y
CONFIG_RPC=y
CONFIG_RPC_YIELD=y
CONFIG_RPC_MAX_SESSIONS=100
CONFIG_OTP=y
CONFIG_GLOBALPLATFORM=y
CONFIG_FS=y
CONFIG_POLL=y
CONFIG_EPOLL=y
CONFIG_DEVFS=y
CONFIG_FATFS=y
CONFIG_RAMFS=y
CONFIG_RAMFS_SIZE=1536
CONFIG_TMPFS=y
CONFIG_DEBUGFS=y
CONFIG_REEFS=y
CONFIG_USER_MBEDCRYPTO=y
CONFIG_KERNEL_MBEDCRYPTO=y
CONFIG_MBEDCRYPTO_CHACHA20=y
CONFIG_MBEDCRYPTO_SHA3=y
CONFIG_MBEDCRYPTO_SM3=y
CONFIG_MBEDCRYPTO_SM4=y
CONFIG_MBEDCRYPTO_SM4_TTABLE=y
CONFIG_MBEDCRYPTO_SM2=y
CONFIG_MBEDCRYPTO_PBKDF2=y
CONFIG_MBEDCRYPTO_CURVE25519=y
CONFIG_MBEDCRYPTO_ED25519_BTABLE=y
CONFIG_MBEDCRYPTO_CURVE448=y
CONFIG_MBEDCRYPTO_DES_TABLE=y
CONFIG_MBEDCRYPTO_AES_SIV=y
CONFIG_USER=y
CONFIG_SYSCALL=y
CONFIG_SPAWN=y
CONFIG_WAITPID=y
CONFIG_USER_PTHREAD=y
CONFIG_SIGNAL=y
CONFIG_USER_BACKTRACE=y
CONFIG_ASLR=y
CONFIG_TEE_API=y
CONFIG_AUTH_TA=y
CONFIG_SIMPLE_SHELL=y
CONFIG_USER_SHELL=y
CONFIG_MBEDTEST=y
CONFIG_MBEDTEST_CRYPTO=y
```

## configs/qemu_xlnx_zcu102_defconfig
```kconfig
CONFIG_AARCH64=y
CONFIG_ARM_GICV2=y
CONFIG_REE=y
CONFIG_QEMU_XLNX_ZCU102=y
CONFIG_NR_CPUS=4
CONFIG_PRINTK=y
CONFIG_BACKTRACE=y
CONFIG_UART=y
CONFIG_UART_POLL=y
CONFIG_UART_CDNS=y
CONFIG_RPC=y
CONFIG_GLOBALPLATFORM=y
CONFIG_FATFS=y
CONFIG_RAMFS=y
CONFIG_REEFS=y
CONFIG_TMPFS=y
CONFIG_DEBUGFS=y
CONFIG_USER=y
CONFIG_IPC_SHM=y
CONFIG_IPC_MSGQ=y
CONFIG_USER_BACKTRACE=y
CONFIG_EPOLL=y
CONFIG_ASLR=y
CONFIG_TEE_API=y
CONFIG_AUTH_TA=y
CONFIG_SIMPLE_SHELL=y
CONFIG_MBEDTEST=y
```

## configs/salix_mips74k_defconfig
```kconfig
CONFIG_MIPS=y
CONFIG_CFLAGS="-EL -mips32r2 -G 0 -mno-mips16 -mno-interlink-mips16 -msoft-float -mxgot -mcode-readable=no"
CONFIG_PIC_CFLAGS="-mabicalls -fPIC"
CONFIG_SALIX_MIPS74K=y
CONFIG_NR_CPUS=1
CONFIG_PRINTK=y
CONFIG_BACKTRACE=y
CONFIG_INTC=y
CONFIG_SALIX_MIPS_INTC=y
CONFIG_UART=y
CONFIG_UART_POLL=y
CONFIG_UART_16550=y
CONFIG_FATFS=y
CONFIG_RAMFS=y
CONFIG_TMPFS=y
CONFIG_DEBUGFS=y
CONFIG_USER=y
CONFIG_IPC_SHM=y
CONFIG_IPC_MSGQ=y
CONFIG_USER_BACKTRACE=y
CONFIG_EPOLL=y
CONFIG_ASLR=y
CONFIG_TEE_API=y
CONFIG_AUTH_TA=y
CONFIG_SIMPLE_SHELL=y
CONFIG_MBEDTEST=y
```

## configs/vexpress_ca17x4_ca7x4_defconfig
```kconfig
CONFIG_ARM_GICV2=y
CONFIG_ARM_BIGLITTLE=y
CONFIG_ARM_CCI=y
CONFIG_REE=y
CONFIG_VEXPRESS_CA17_CA7=y
CONFIG_NR_CPUS=8
CONFIG_PRINTK=y
CONFIG_BACKTRACE=y
CONFIG_UART=y
CONFIG_UART_POLL=y
CONFIG_UART_PL011=y
CONFIG_RPC=y
CONFIG_GLOBALPLATFORM=y
CONFIG_FATFS=y
CONFIG_RAMFS=y
CONFIG_REEFS=y
CONFIG_TMPFS=y
CONFIG_DEBUGFS=y
CONFIG_USER=y
CONFIG_IPC_SHM=y
CONFIG_IPC_MSGQ=y
CONFIG_USER_BACKTRACE=y
CONFIG_EPOLL=y
CONFIG_ASLR=y
CONFIG_TEE_API=y
CONFIG_AUTH_TA=y
CONFIG_SIMPLE_SHELL=y
CONFIG_MBEDTEST=y
```

## configs/vexpress_ca5_defconfig
```kconfig
CONFIG_REE=y
CONFIG_NR_CPUS=4
CONFIG_PRINTK=y
CONFIG_BACKTRACE=y
CONFIG_UART=y
CONFIG_UART_POLL=y
CONFIG_UART_PL011=y
CONFIG_ARMV7_PRIVATE_TIMER=y
CONFIG_RPC=y
CONFIG_GLOBALPLATFORM=y
CONFIG_FATFS=y
CONFIG_RAMFS=y
CONFIG_REEFS=y
CONFIG_TMPFS=y
CONFIG_DEBUGFS=y
CONFIG_USER=y
CONFIG_IPC_SHM=y
CONFIG_IPC_MSGQ=y
CONFIG_USER_BACKTRACE=y
CONFIG_EPOLL=y
CONFIG_ASLR=y
CONFIG_TEE_API=y
CONFIG_AUTH_TA=y
CONFIG_SIMPLE_SHELL=y
CONFIG_MBEDTEST=y
```

## core/Kconfig
```kconfig
# SPDX-License-Identifier: Apache-2.0
# Copyright (c) 2019 KapaXL (kapa.xl@outlook.com)

menu "General Setup"

config NR_CPUS
	int "CPU Cores Num"
	help
		Configure the number of the CPU cores.

config PRINTK
	bool "Enable printk"
	help
		Say Y here to enable the kernel print.

config TRACE_LEVEL
	int "xMSG level"
	default 3
	depends on PRINTK
	help
		Configure the kernel trace xMSG level.
		TRACE_LEVEL_IGNORE 0
		TRACE_LEVEL_ERROR  1
		TRACE_LEVEL_WARN   2
		TRACE_LEVEL_INFO   3
		TRACE_LEVEL_DEBUG  4
		TRACE_LEVEL_LOG    5
		TRACE_LEVEL_FS     6

config VMALLOC
	bool "Enable vmalloc"
	default y
	depends on MMU
	help
		Say Y to enable usage the on the contiguous
		virtual address space mmaped with scattered pages

config STACK_PROTECTOR
	bool "Enable stack protector"
	default y
	help
		Say Y here to enable the stack protector.

config BACKTRACE
	bool "Enable kernel unwind backtrace"
	help
		Say Y here to enable the kernel unwind backtrace.

config EMBEDDED_DTB
	bool "Enable the embedded DTB"
	default y
	help
		Say Y to use the embedded DTB,
	  	DTB will be linked into kernel

config DTB_ADDR
	hex "DTB load address"
	default 0x82000000
	depends on !EMBEDDED_DTB
	help
		Configure the external DTB address
		in case of EMBEDDED_DTB is not enabled.

source "core/elf/Kconfig"

config OS_ADDR
	hex "OS link address"
	default 0x80100000 if MIPS32
	default 0xC0000000 if AARCH32 && USER
	default 0x80100000 if AARCH32 && !USER
	default 0xC0000000 if RISCV32 && USER
	default 0x80000000 if RISCV32 && !USER
	default 0x80000000 if AARCH64 && !USER
	default 0x80000000 if RISCV64 && !USER
	default 0xFFFFFFE000000000 if RISCV64 && USER
	default 0xFFFFFFC000000000 if AARCH64 && USER
	help
		Configure the OS destination link address.

endmenu
```

## core/elf/Kconfig
```kconfig
# SPDX-License-Identifier: Apache-2.0
# Copyright (c) 2019 Xing Loong <xing.xl.loong@gmail.com>

config ELF_LOADER
	bool "Enable support the ELF loader"
	depends on USER
	select VMALLOC
	default y
	help
		Say Y here to enable support the ELF loader.
```

## core/ipc/Kconfig
```kconfig
# SPDX-License-Identifier: Apache-2.0
# Copyright (c) 2019 Xing Loong <xing.xl.loong@gmail.com>

menu "IPC"

config IPC_PIPE
	bool "Enable pipe()"
	depends on FS
	default y if USER
	help
		Enable the pipe() implementation.

config IPC_SEM
	bool "Enable semaphores (sem_*)"
	depends on FS
	default y if USER
	help
		Enable POSIX unnamed semaphores.

config IPC_EVENTFD
	bool "Enable eventfd()"
	depends on FS
	default y if USER
	help
		Enable eventfd() support (pollable event counter).

config IPC_SHM
	bool "Enable POSIX Shared Memory"
	depends on TMPFS && USER
	help
		Say Y here to enable the POSIX Shared Memory

config IPC_MSGQ
	bool "Enable POSIX Message Queue"
	depends on TMPFS && USER
	help
		Say Y here to enable the POSIX Message Queue

endmenu
```

## drivers/Kconfig
```kconfig
# SPDX-License-Identifier: Apache-2.0
# Copyright (c) 2019 KapaXL (kapa.xl@outlook.com)

menu "Device Drivers"

source "drivers/base/Kconfig"

if DRIVER_BASE

source "drivers/rng/Kconfig"
source "drivers/intc/Kconfig"
source "drivers/uart/Kconfig"
source "drivers/rpc/Kconfig"

source "drivers/globalplatform/Kconfig"

endif

endmenu
```

## drivers/base/Kconfig
```kconfig
# SPDX-License-Identifier: Apache-2.0
# Copyright (c) 2019 KapaXL (kapa.xl@outlook.com)

config DRIVER_BASE
	bool
	select DEVFS
	default y
	help
		Say Y here to enable basic device/driver methods
```

## drivers/globalplatform/Kconfig
```kconfig
# SPDX-License-Identifier: Apache-2.0
# Copyright (c) 2019 KapaXL (kapa.xl@outlook.com)

config GLOBALPLATFORM
	bool "GlobalPlatform"
	depends on SYSCALL
	default n
	help
		Say Y here to enable the GlobalPlatform functions.
		e.g. the IPC open/invoke/close another TA session, TEE_GetREETime etc.
```

## drivers/intc/Kconfig
```kconfig
# SPDX-License-Identifier: Apache-2.0
# Copyright (c) 2019 KapaXL (kapa.xl@outlook.com)

config INTC
	bool "Interrupt-Controller @ SoC"
	default n
	help
		Say Y here to enable the SoC (or Platform) Side interrupt-controller.
		these interrupt-controller connects to the CPU IRQ pin

if INTC

config INTEL_I8259
	bool "intel i8259"
	depends on MIPS
	help
		Enable Intel i8259 interrupt-controller.

config RISCV_PLIC
	bool "riscv plic"
	depends on RISCV
	help
		Enable riscv plic interrupt-controller.

config RISCV_APLIC
	bool "riscv aplic"
	depends on RISCV
	help
		Enable riscv aplic interrupt-controller.

config RISCV_IMSIC
	bool "riscv imsic"
	depends on RISCV
	select RISCV_APLIC
	help
		Enable riscv aplic-imsic interrupt-controller.

config SALIX_MIPS_INTC
	bool "salix intc of mips"
	depends on MIPS
	help
		Enable salix MIPS SoC interrupt-controller.

config SALIX_ARM_INTC
	bool "salix intc of arm"
	depends on ARM
	help
		Enable salix ARM SoC interrupt-controller.
		usually connects to the ARM GIC

config ASPEED_AST2700_INTC
	bool "aspeed AST2700 intc"
	depends on ARM
	help
		Enable ASpeed AST2700 SoC interrupt-controller.
		connects to the ARM GIC

config XLNX_INTC
	bool "xlnx xps-intc"
	help
		Enable xilinx interrupt-controller.

endif
```

## drivers/otp/Kconfig
```kconfig
# SPDX-License-Identifier: Apache-2.0
# Copyright (c) 2019 Xing Loong <xing.xl.loong@gmail.com>

config OTP
	bool "OTP Driver Support"
	default y
	help
	  Enable OTP (One-Time Programmable) driver support.
```

## drivers/rng/Kconfig
```kconfig
# SPDX-License-Identifier: Apache-2.0
# Copyright (c) 2019 Xing Loong <xing.xl.loong@gmail.com>

config RNG
	bool "RNG module"
	default y
	help
		Say Y here to enable the RNG framework.

if RNG
config PRNG
	bool "pseudo RNG"
	default y
	help
		Say Y here to enable the PRNG by software.
endif
```

## drivers/rpc/Kconfig
```kconfig
# SPDX-License-Identifier: Apache-2.0
# Copyright (c) 2019 Xing Loong <xing.xl.loong@gmail.com>

config RPC
	bool "RPC module"
	depends on REE
	default n
	help
		Say Y here to enable RPC caller/fast-callee

config RPC_YIELD
	bool "RPC yield"
	depends on USER && RPC
	default y
	help
		Say Y here to enable support RPC YieldCall / RPC SHM (callee)
		current RPC YieldCall/SHM follows the GlobalPlatform style

config RPC_MAX_SESSIONS
	int "Maximum number of concurrent RPC sessions"
	depends on RPC_YIELD
	default 100
	range 1 256
	help
		Maximum number of concurrent RPC sessions that the REE
		can open simultaneously. This prevents a malicious REE
		from exhausting TEE memory by creating unlimited sessions.

config RPC_R2T_POLL_1MS
	bool "R2T ring polling fallback (1ms)"
	depends on RPC && RISCV
	default y
	help
		Enable periodic 1ms polling of the REE->TEE RPC ring.

		Use this when REE cannot send an IMSIC doorbell interrupt to
		the TEE (for example, disjoint Linux/TEE hart topology where
		direct MMIO notify is unavailable or intentionally disabled).

		When enabled, TEE checks the r2t ring every 1ms and processes
		pending RPC entries without requiring an external IRQ trigger.
```

## drivers/timer/Kconfig
```kconfig
# SPDX-License-Identifier: Apache-2.0
# Copyright (c) 2025 KapaXL (kapa.xl@outlook.com)

config TIMER
	bool "Timer module"
	default y
	help
		Say Y here to enable the Timer module.
		Common timers and the architecture independent timers.

if TIMER

choice
	prompt "ARMV7 Timer Selection"
	default ARMV7_GENERIC_TIMER
	depends on AARCH32
config ARMV7_GENERIC_TIMER
	bool "armv7 generic timer"
	help
		Say Y here to enable support AArch32@ARMV7-A generic timer.
		usually for Cortex-A7/A15/A17
config ARMV7_GLOBAL_TIMER
	bool "armv7 global timer"
	help
		Say Y here to enable support AArch32@ARMV7-A global timer.
		usually for Cortex-A5/A9
config ARMV7_PRIVATE_TIMER
	bool "armv7 private timer"
	help
		Say Y here to enable support AAarch32@ARMV7-A private timer.
		usually for Cortex-A5/A9
endchoice

config ARMV8_GENERIC_TIMER
	bool "armv8 generic timer"
	depends on AARCH64
	default y
	help
		Say Y here to enable support AArch64@ARMV8-A generic timer.

config RISCV_TIMER
	bool "riscv sstc timer"
	depends on RISCV_S_MODE
	help
		Enables the per-hart RISCV timer

config CLINT_TIMER
	bool "riscv clint timer"
	depends on RISCV && !RISCV_S_MODE
	help
		Enables the CLINT timer. CLINT timer
		usually used on	M-Mode RISCV systems.

config XLNX_TIMER
	bool "xlnx xps timer"
	default n
	help
		Enable xlnx timer @ microblaze-v platform

endif
```

## drivers/uart/Kconfig
```kconfig
# SPDX-License-Identifier: Apache-2.0
# Copyright (c) 2019 KapaXL (kapa.xl@outlook.com)

config UART
	bool "UART module"
	help
		Say Y here to enable the UART module.

if UART

config UART_POLL
	bool "UART Poll RX"
	help
		Enable UART periodic polling on RX.

choice
	prompt "UART Selection"

config UART_16550
	bool "UART 16550A"
	help
		Enable UART 16550A.
config UART_PL011
	bool "UART PL011"
	help
		Enable ARM PL011 UART.
config UART_SIFIVE
	bool "UART SiFive"
	help
		Enable SiFive UART.
config UART_CDNS
	bool "UART Cadence"
	help
		Enable Cadence UART.
config UART_IMX
	bool "UART IMX"
	help
		Enable IMX UART.

endchoice

endif
```
