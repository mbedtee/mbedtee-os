## fs/Kconfig
```kconfig
# SPDX-License-Identifier: Apache-2.0
# Copyright (c) 2019 Xing Loong <xing.xl.loong@gmail.com>

menu "File Systems"

config FS
	bool
	default y
	help
		Say Y here to enable support for the file systems.
		By default this option is essential.

if FS

menu "I/O Multiplexing"

config POLL
	bool "Enable poll()"
	default y
	help
		Enable poll() support.
		- Kernel: provides poll() implementation (and do_syscall_poll backend).
		- Userspace: enables the poll syscall wrapper and libc API.

config EPOLL
	bool "Enable epoll"
	depends on SYSCALL && TMPFS
	help
		Enable epoll support.
		Requires the userspace syscall layer and tmpfs (epoll uses tfs nodes).

endmenu

config DEVFS
	bool "Support the devfs file system"
	default y
	help
		Say Y here to enable support for the devfs
		/dev for the devices drivers.
		By default this option is essential.

config FATFS
	bool "Support the fatfs (fat12/16/32)"
	help
		Say Y here to enable support for FATFS.
		By default this option is essential.

config RAMFS
	bool "Support the ramfs (based on fatfs)"
	depends on FATFS
	help
		Say Y here to enable support for RAMFS.
		By default this option is essential.

config TMPFS
	bool "Support the tmpfs"
	help
		Say Y here to enable support for tmpfs,
		POSIX Shared Memory, message queue and debugfs etc. depend on it.
		By default this option is essential.

config DEBUGFS
	bool "Support the debugfs (based on TMPFS)"
	depends on TMPFS
	help
		Say Y here to support the debugfs for OS or OS driver modules.

config FILE_DEBUG
	bool "File open/close tracking"
	depends on DEBUGFS
	help
		Track all open files in a global list with owner names.
		When enabled, creates /debugfs/files to show all open files.
		Say N for production builds to save memory and reduce locking.

config REEFS
	bool "Support the REE file system"
	depends on RPC && KERNEL_MBEDCRYPTO
	help
		Say Y here to enable support for REEFS
		for the TA Trusted Storage.

config REEFS_ANTIROLLBACK_RPMB
	bool "REEFS anti-rollback protection via RPMB"
	depends on REEFS && RPMBFS
	help
		Say Y here to enable anti-rollback protection for REEFS.
		This mirrors file headers to RPMB to detect and prevent
		rollback attacks on REE-stored files.

config RPMBFS
	bool "Support the RPMB file system"
	depends on RPC && KERNEL_MBEDCRYPTO
	help
		Say Y here to enable support for the RPMB FS
		for the Secure Storage.

config RPMB_FS_MAX_FILES
	int "Maximum number of files in RPMB"
	depends on RPMBFS
	default 128
	help
		Define the maximum number of files that can be stored in RPMB.
		This affects the memory usage (RAM) and the reserved area on RPMB.
		Each entry takes 256 bytes in RAM and on Disk.

config RPMB_FS_CACHE_ENTRIES
	int "Number of FAT entries to cache in RAM"
	depends on RPMBFS
	default 128
	range 0 1024
	help
		Cache FAT entries in RAM for performance.
		CRITICAL: This value MUST be >= number of files in RPMB.
		Files in FAT slots beyond cache size will be inaccessible!
		Set to CONFIG_RPMB_FS_MAX_FILES to ensure all files are cached.
		Memory usage: N x 256 bytes (e.g., 128 entries = 32KB RAM).
		Set to 0 to disable caching (slow, reads FAT from RPMB on demand).

config RPMB_FS_READ_BATCH
	int "RPMB read batch size (blocks)"
	depends on RPMBFS
	default 32
	range 1 32
	help
		Maximum number of RPMB blocks to read in a single operation.
		Each block is 256 bytes. Maximum batch: 32 blocks = 8KB.

config RPMB_FS_WRITE_BATCH
	int "RPMB write batch size (blocks)"
	depends on RPMBFS
	default 32
	range 1 32
	help
		Maximum number of RPMB blocks to write in a single operation.
		Each block is 256 bytes. Maximum batch: 32 blocks = 8KB.
endif

endmenu
```

## lib/Kconfig
```kconfig
# SPDX-License-Identifier: Apache-2.0
# Copyright (c) 2019 Xing Loong <xing.xl.loong@gmail.com>

menu "Libraries"

source "lib/mbedcrypto/Kconfig"

endmenu
```

## lib/fdt/Kconfig
```kconfig
# SPDX-License-Identifier: Apache-2.0
# Copyright (c) 2019 KapaXL (kapa.xl@outlook.com)

config FDT_LIB
	bool "Enable the FDT library"
	default y
	help
		Say Y here to enable support the FDT library.
```

## lib/mbedcrypto/Kconfig
```kconfig
# SPDX-License-Identifier: Apache-2.0
# Copyright (c) 2025 Xing Loong <xing.xl.loong@gmail.com>

config USER_MBEDCRYPTO
	bool "Support the user mbedcrypto library"
	depends on USER
	default y
	help
		Say Y here to enable user mbedcrypto library.

		Default algorithms (always built):
		  Hash:      MD5, SHA-1, SHA-224, SHA-256, SHA-384, SHA-512
		  Cipher:    AES (ECB/CBC/CTR/CTS/XTS), DES/3DES (ECB/CBC/CTS)
		  AEAD:      AES-GCM, AES-CCM
		  MAC:       HMAC, AES-CMAC, AES/DES/3DES-CBC-MAC
		  Asymmetric: RSA (PKCS#1 v1.5, PSS, OAEP), DSA, ECDSA, ECDH, DH
		  KDF:       HKDF
		  Curves:    SECP192/256/384/521R1, BP256/384/512R1

		Optional algorithms (enable via sub-options below):
		  ChaCha20-Poly1305, SHA-3, SM3, SM4, SM2, PBKDF2,
		  Curve25519/Ed25519/X25519, Curve448/Ed448/X448, AES-SIV

config KERNEL_MBEDCRYPTO
	bool "Support the kernel mbedcrypto library"
	default y
	help
		Say Y here to enable kernel mbedcrypto library.

		Kernel subset (always built):
		  Hash:   SHA-256
		  Cipher: AES (ECB/CBC/CTR)
		  AEAD:   AES-GCM
		  KDF:    HKDF

if USER_MBEDCRYPTO

config MBEDCRYPTO_CHACHA20
	bool "ChaCha20-Poly1305 AEAD cipher"
	default n
	help
		Say Y here to enable ChaCha20-Poly1305 AEAD cipher
		(RFC 7539).

config MBEDCRYPTO_SHA3
	bool "SHA-3 hash family (SHA3-224/256/384/512)"
	default n
	help
		Say Y here to enable SHA-3 hash algorithms
		(FIPS 202).

config MBEDCRYPTO_SM3
	bool "SM3 cryptographic hash (GB/T 32905-2016)"
	default n
	help
		Say Y here to enable the SM3 hash algorithm.

config MBEDCRYPTO_SM4
	bool "SM4 block cipher (GB/T 32907-2016)"
	default n
	help
		Say Y here to enable the SM4 block cipher.

config MBEDCRYPTO_SM4_TTABLE
	bool "SM4 T-table acceleration"
	depends on MBEDCRYPTO_SM4
	default n
	help
		Say Y here to use a 1KB precomputed T-table for SM4
		round function acceleration. Trades read-only memory
		for faster encryption/decryption.

config MBEDCRYPTO_SM2
	bool "SM2 digital signature and public key encryption"
	depends on MBEDCRYPTO_SM3
	default n
	help
		Say Y here to enable SM2 algorithms (SM2DSA and
		SM2PKE). Requires SM3.

config MBEDCRYPTO_PBKDF2
	bool "PBKDF2 key derivation"
	default n
	help
		Say Y here to enable PBKDF2 password-based key
		derivation (RFC 2898).

config MBEDCRYPTO_CURVE25519
	bool "Curve25519 / Ed25519 / X25519"
	default n
	help
		Say Y here to enable Curve25519-based algorithms:
		Ed25519 signature and X25519 key agreement.

config MBEDCRYPTO_ED25519_BTABLE
	bool "Curve25519 B-table acceleration"
	depends on MBEDCRYPTO_CURVE25519
	default n
	help
   		Say Y here to enable Curve25519 precomputed basepoint table.
		Built once at first use. 16 x 160 bytes = 2.5 KB BSS.

config MBEDCRYPTO_CURVE448
	bool "Curve448 / Ed448 / X448"
	default n
	help
		Say Y here to enable Curve448-based algorithms:
		Ed448 signature and X448 key agreement.

config MBEDCRYPTO_DES_TABLE
	bool "DES SP-table acceleration"
	default y
	help
		Say Y here to use precomputed SP lookup tables (2048 bytes)
		for DES/3DES round function. Provides faster encryption at
		the cost of additional read-only memory.
		If N, uses factored S-box + P-permutation tables (1024 bytes)
		with two-level lookups per S-box.

config MBEDCRYPTO_AES_SIV
	bool "AES-SIV deterministic AEAD"
	default n
	help
		Say Y here to enable AES-SIV (RFC 5297)
		deterministic authenticated encryption.

endif # USER_MBEDCRYPTO
```

## lib/mbedtls/Kconfig
```kconfig
# SPDX-License-Identifier: Apache-2.0
# Copyright (c) 2019 KapaXL (kapa.xl@outlook.com)

config USER_MBEDTLS
	bool "Support the user mbedtls library"
	depends on USER
	default y
	help
		Say Y here to enable user mbedtls library.

config USER_MBEDTLS_PSA
	bool "Support the user mbedtls PSA"
	depends on USER_MBEDTLS
	default n
	help
		Say Y here to enable user mbedtls PSA.

config USER_MBEDTLS_X509
	bool "Support the user mbedtls X509"
	depends on USER_MBEDTLS
	default n
	help
		Say Y here to enable user mbedtls X509.

config USER_MBEDTLS_SSL
	bool "Support the user mbedtls SSL"
	depends on USER_MBEDTLS
	default n
	help
		Say Y here to enable user mbedtls SSL.

config KERNEL_MBEDTLS
	bool "Support the kernel mbedtls library"
	default y
	help
		Say Y here to enable kernel mbedtls library.
```

## platform/Kconfig
```kconfig
# SPDX-License-Identifier: Apache-2.0
# Copyright (c) 2019 KapaXL (kapa.xl@outlook.com)

menu "Platform Configure"

choice
	prompt "Platform Selection"

config VEXPRESS_CA5
	bool "FVP CA5x4"
	depends on AARCH32
	help
		support below FVP platforms:
		FVP_VE_Cortex_A5x4, FVP_VE_Cortex_A9x4

config VEXPRESS_CA15
	bool "FVP CA15x4"
	depends on AARCH32
	help
		support below FVP platforms:
		FVP_VE_Cortex_A15x4, FVP_VE_Cortex_A7x4
		FVP_VE_Cortex_A17x4

config VEXPRESS_CA17_CA7
	bool "FVP big.LITTLE A17x4-A7x4"
	depends on AARCH32
	help
		select the FVP platforms:
		FVP_VE_Cortex_A17x4_A7x4
		FVP_VE_Cortex_A15x4_A7x4

config VEXPRESS_CA53
	bool "FVP A53x4"
	depends on AARCH64
	help
		support below FVP platforms:
	 	FVP_Base_Cortex_A53x4, FVP_Base_Cortex_A35x4
	 	FVP_Base_Cortex_A57x4, FVP_Base_Cortex_A72x4
	 	FVP_Base_Cortex_A73x4

config VEXPRESS_CA78
	bool "FVP A78x4"
	depends on AARCH64
	help
		support below FVP platforms:
		FVP_Base_Cortex_A55x4, FVP_Base_Cortex_A75x4
		FVP_Base_Cortex_A76x4, FVP_Base_Cortex_A77x4
		FVP_Base_Cortex_A78x4, FVP_Base_Cortex_X1x4
		FVP_Base_Cortex_A510x4, FVP_Base_Cortex_A710x4
		FVP_Base_Cortex_X2x4, FVP_Base_Neoverse_N1x4
		FVP_Base_Neoverse_V1x4, FVP_Base_Neoverse_N2x4

config VEXPRESS_CA65
	bool "FVP A65x8 MultiThreading"
	depends on AARCH64
	help
		support below FVP platforms:
		FVP_Base_Cortex_A65, FVP_Base_Cortex_A65AE
		FVP_Base_Neoverse_E1
		(Each core has 2 threads, total 8x2=16 threads)

config VEXPRESS_CA73_CA53
	bool "FVP A73x4-A53x4 big.LITTLE"
	depends on AARCH64
	help
		select the FVP platform:
		FVP_Base_Cortex_A73x4_A53x4
		FVP_Base_Cortex_A72x4_A53x4
		FVP_Base_Cortex_A57x4_A53x4
		FVP_Base_Cortex_A72x4_A35x4
		FVP_Base_Cortex_A57x4_A35x4

config VEXPRESS_CA510_CA710
	bool "FVP A510x4-A710x4 big.LITTLE"
	depends on AARCH64
	help
		select the FVP platforms:
		FVP_Base_Cortex_A510x4_A710x4
		FVP_Base_Cortex_A55x4_A75x4
		FVP_Base_Cortex_A55x4_A78x4

config QEMU_VIRT_ARM
	bool "QEMU Virt AArch32@ARMV7-A"
	depends on AARCH32
	help
		select the QEMU -M virt platforms:
		Cortex-A15x4 or Cortex-A7x4

config QEMU_VIRT_AARCH64
	bool "QEMU Virt @ AArch64"
	depends on AARCH64
	help
		select the QEMU -M virt aarch64 platforms:
		Cortex-A35x4, Cortex-A53x4, Cortex-A55x4
		Cortex-A57x4, Cortex-A72x4, Cortex-A76x4
		Cortex-A710x4, Neoverse-N1x4, Neoverse-V1x4
		Neoverse-N2x4

config QEMU_MALTA_MIPS32R2
	bool "QEMU Malta MIPS32R2"
	depends on MIPS32
	help
		select the QEMU Malta MIPS32R2 platforms
		e.g. 24Kf 24Kc 34Kf 74Kf M14Kc P5600

config QEMU_VIRT_RISCV32
	bool "QEMU Virt RISCV32"
	depends on RISCV32
	help
		select the QEMU Virt RISCV32 platform

config QEMU_VIRT_RISCV64
	bool "QEMU Virt RISCV64"
	depends on RISCV64
	help
		select the QEMU Virt RISCV64 platform

config QEMU_SIFIVE_U_RISCV32
	bool "QEMU SiFive_U RISCV32"
	depends on RISCV32
	help
		select the QEMU sifive_u RISCV32 platform

config QEMU_SIFIVE_U_RISCV64
	bool "QEMU SiFive_U RISCV64"
	depends on RISCV64
	help
		select the QEMU sifive_u RISCV64 platform

config SALIX_CA7
	bool "SALIX_CA7x4"
	depends on AARCH32
	help
		select the salix Cortex-A7x4(aarch32) platform

config SALIX_MIPS74K
	bool "SALIX_MIPS74K"
	depends on MIPS32
	help
		select the salix MIPS74K(mips32r2) platform

endchoice

endmenu
```
