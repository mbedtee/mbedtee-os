// SPDX-License-Identifier: Apache-2.0
/*
 * Copyright (c) 2025 Xing Loong <xing.xl.loong@gmail.com>
 */

/{
	#address-cells = <2>;
	#size-cells = <2>;

	memory@0 {
		compatible = "memory";
		device_type = "memory";

		/*
		 * SoC installed memory mapping, this is a guideline for OS
		 * to setup the early mmu-memory-section-mapping
		 *
		 * Andes AE350 RISCV64 platform with 2G Bytes memory installed:
		 * DRAM starts at 0x0
		 */
		mapping = <0 0x0 0 0x80000000>;

		/* dedicated memory region for current OS */
		reg = <0 0x0 0 0x5800000>;

		/* TAs loaded from REE will be placed in this area */
		ta-ramfs = <0 0x5A00000 0 0x200000>;

		rpc-t2r-ring = <0 0x5F10000 0 0x20000>;
		rpc-t2r-shm = <0 0x5F30000 0 0x40000>;
		rpc-r2t-ring = <0 0x5F70000 0 0x20000>;
	};
};
