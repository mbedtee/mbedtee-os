/*
 * SPDX-License-Identifier: Apache-2.0
 * Copyright (c) 2025 KapaXL (kapa.xl@outlook.com)
 */

/{
	#address-cells = <2>;
	#size-cells = <2>;

	memory@1000 {
		compatible = "memory";
		device_type = "memory";
		/*
		 * SoC installed memory mapping, this is a guideline for OS
		 * to setup the early mmu-memory-section-mapping
		 *
		 * Mandatory node for ARM, MIPS SoC does not require it,
		 * since MIPS already has the fix-mapping-table in MMU.
		 *
		 * e.g. QEMU raspi4b phys memory start from 0, max 2GB
		 */
		mapping = <0 0x00000000 0 0x80000000>;

		/* dedicated memory region for current OS */
		reg = <0 0x00000000 0 0x5800000>;

		/* TAs loaded from REE will be placed in this area */
		ta-ramfs = <0 0x05A00000 0 0x200000>;

		ree-dtb = <0 0x05F00000 0 0x10000>;
		rpc-t2r-ring = <0 0x05F10000 0 0x20000>;
		rpc-t2r-shm = <0 0x05F30000 0 0x40000>;
		ree-addr = <0 0x06000000 0 0x1800000>;
	};
};
