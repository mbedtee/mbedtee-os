/*
 * SPDX-License-Identifier: Apache-2.0
 * Copyright (c) 2019 KapaXL (kapa.xl@outlook.com)
 */

/{
	#address-cells = <2>;
	#size-cells = <2>;

	memory@40000000 {
		compatible = "memory";
		device_type = "memory";
		/*
		 * SoC installed memory mapping, this is a guideline for OS
		 * to setup the early mmu-memory-section-mapping
		 *
		 * Mandatory node for ARM, MIPS SoC does not require it,
		 * since MIPS already has the fix-mapping-table in MMU.
		 *
		 * e.g. QEMU imx8mp phys memory regions:
		 *
		 * 0x40000000 ~ ffffffff         [size：0xc0000000]
		 */
		mapping = <0 0x40000000 0 0x80000000>;

		/* dedicated memory region for current OS */
		reg = <0 0x40000000 0 0x5800000>;

		/* TAs loaded from REE will be placed in this area */
		ta-ramfs = <0 0x45A00000 0 0x200000>;

		ree-dtb = <0 0x45F00000 0 0x10000>;
		rpc-t2r-ring = <0 0x45F10000 0 0x20000>;
		rpc-t2r-shm = <0 0x45F30000 0 0x40000>;
		ree-addr = <0 0x46000000 0 0x1800000>;
	};
};
