/*
 * SPDX-License-Identifier: Apache-2.0
 * Copyright (c) 2019 KapaXL (kapa.xl@outlook.com)
 */

/{
	#address-cells = <1>;
	#size-cells = <1>;

	memory@80000000 {
		compatible = "memory";
		device_type = "memory";

		/*
		 * SoC installed memory mapping, this is a guideline for OS
		 * to setup the early mmu-memory-section-mapping
		 *
		 * Mandatory node for ARM/RISCV, MIPS SoC does not require it,
		 * since MIPS already has the fix-mapping-table in MMU.
		 *
		 * e.g. RISCV32 QEMU Sifive-U platform with 2G Bytes memory installed:
		 */
		mapping = <0x80000000 0x80000000>;

		/* dedicated memory region for current OS */
		reg = <0x80000000 0x5800000>;
			/* top 64M is reserved for kernel vma,
			shouldn't be physical memory, e.g.
			<0xF0000000 0x0C000000>;*/

		/* TAs loaded from REE will be placed in this area */
		ta-ramfs = <0x85A00000 0x200000>;

		rpc-t2r-ring = <0x85F10000 0x20000>;
		rpc-t2r-shm = <0x85F30000 0x40000>;
		rpc-r2t-ring = <0x85F70000 0x20000>;
	};
};
