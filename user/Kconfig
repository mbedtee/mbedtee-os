## user/Kconfig
```kconfig
# SPDX-License-Identifier: Apache-2.0
# Copyright (c) 2019 Xing Loong <xing.xl.loong@gmail.com>

menu "UserSpace"

config USER
	bool "Enable the user space"
	select MMU
	select SYSCALL
	select ELF_LOADER
	help
		Say Y here to enable support for the user space.

if USER

config SYSCALL
	bool "Enable syscall layer"
	depends on FS
	default y
	help
		Enable the userspace syscall layer (SVC/syscall handler and user wrappers).
		Pure kernel-mode builds should keep this disabled.

config SPAWN
	bool "Enable process spawn"
	default y
	help
		Enable posix_spawn*() support.
		Pure kernel-mode builds typically don't need these.

config WAITPID
	bool "Enable waitpid"
	default y
	help
		Enable waitpid() support for waiting/reaping child processes.
		This is semantically independent from CONFIG_SPAWN.

config USER_PTHREAD
	bool "Enable POSIX thread"
	default y
	help
		Say Y here to enable the userspace POSIX thread library.

config SIGNAL
	bool "Enable POSIX Signal"
	default y
	help
		Say Y here to enable the userspace POSIX signals.

config USER_BACKTRACE
	bool "Enable userspace unwind backtrace"
	depends on ELF_LOADER
	help
		Say Y here to enable the userspace unwind backtrace.

config ASLR
	bool "Enable userspace ASLR"
	help
		Say Y here to enable the userspace ASLR
		(Address Space Layout Random).

config TEE_API
	bool "Enable userspace GlobalPlatform APIs"
	help
		Say Y here to enable GlobalPlatform Internal Core APIs.

endif

endmenu
```
