## Kconfig
```kconfig
# SPDX-License-Identifier: Apache-2.0
# Copyright (c) 2019 Xing Loong <xing.xl.loong@gmail.com>

mainmenu "$(PRODUCT) $(PRODUCT_VERSION)"

source "arch/Kconfig"

source "platform/Kconfig"

source "core/Kconfig"

source "core/ipc/Kconfig"

source "drivers/Kconfig"

source "fs/Kconfig"

source "lib/Kconfig"

source "user/Kconfig"

source "apps/Kconfig"
```

## apps/Kconfig
```kconfig
# SPDX-License-Identifier: Apache-2.0
# Copyright (c) 2019 Xing Loong <xing.xl.loong@gmail.com>
#
# Default Apps embedded in OS
#

menu "Applications"

source "apps/auth_ta/Kconfig"
source "apps/shell/Kconfig"
source "apps/mbedtest/Kconfig"

endmenu
```

## apps/auth_ta/Kconfig
```kconfig
# SPDX-License-Identifier: Apache-2.0
# Copyright (c) 2019 KapaXL (kapa.xl@outlook.com)

config AUTH_TA
	bool "Authorizer TA"
	depends on USER
	help
		Say Y here to enable Authorizer TA.
		Authorizer to decrypt/verify other dynamic TAs
```

## apps/mbedtest/Kconfig
```kconfig
# SPDX-License-Identifier: Apache-2.0
# Copyright (c) 2019 Xing Loong <xing.xl.loong@gmail.com>

config MBEDTEST
	bool "Test TA"
	depends on USER
	select POLL
	select SPAWN
	select WAITPID
	default n
	help
		Say Y here to enable Test TA.

config MBEDTEST_CRYPTO
	bool "mbedcrypto test suite in Test TA"
	depends on MBEDTEST
	select USER_MBEDCRYPTO
	default n
	help
		Say Y here to include the mbedcrypto test suite
		(--crypto option) in the Test TA.
```

## apps/shell/Kconfig
```kconfig
# SPDX-License-Identifier: Apache-2.0
# Copyright (c) 2019 KapaXL (kapa.xl@outlook.com)

config SIMPLE_SHELL
	bool "Simple Shell"
	default y
	help
		Say Y here to enable the simple shell

if SIMPLE_SHELL
choice
	prompt "Shell Selection"
	default USER_SHELL

config USER_SHELL
	bool "Shell commands @ user-space"
	depends on USER
	help
		Enable support the shell commands @ user-space.

config KERN_SHELL
	bool "Shell commands @ kernel-space"
	depends on UART
	help
		Enable support the shell commands @ kernel-space.
endchoice

endif
```

## arch/Kconfig
```kconfig
# SPDX-License-Identifier: Apache-2.0
# Copyright (c) 2019 Xing Loong <xing.xl.loong@gmail.com>

choice
	prompt "Architecture Choice"

config ARM
	bool "ARM"

config MIPS
	bool "MIPS"

config RISCV
	bool "RISCV"

endchoice

source "arch/arm/Kconfig"
source "arch/mips/Kconfig"
source "arch/riscv/Kconfig"
```

## arch/arm/Kconfig
```kconfig
# SPDX-License-Identifier: Apache-2.0
# Copyright (c) 2019 KapaXL (kapa.xl@outlook.com)

menu "ARM Architecture"
	depends on ARM

choice
	prompt "ARM Selection"

config AARCH32
	bool "aarch32"

config AARCH64
	bool "aarch64"
	select 64BIT

endchoice

source "arch/arm/common/Kconfig"

source "arch/arm/aarch32/Kconfig"

source "arch/arm/aarch64/Kconfig"

endmenu
```

## arch/arm/aarch32/Kconfig
```kconfig
# SPDX-License-Identifier: Apache-2.0
# Copyright (c) 2019 KapaXL (kapa.xl@outlook.com)

if AARCH32

config REE_THREAD
	bool "REE Thread"
	depends on REE
	default n
	help
		Say Y here to create a virtual thread under TEE control,
		thus TEE scheduler can easily balance the CPU time slice.

config IRQ_FORWARD
	bool "Forward IRQ to REE"
	depends on REE
	default y
	help
		Say Y here to support forward ARM IRQ from TEE to REE.
		Means that the REE-IRQ will not be disabled when TEE is
		running, this cloud improve the REE-IRQ response latency.

config CFLAGS
	string "AARCH32_CFLAGS"
	default "-mno-thumb-interwork -marm -march=armv7-a -mfloat-abi=soft -mno-unaligned-access"
	help
		Define the default compile FLAGS.

config PIC_CFLAGS
	string "AARCH32_PIC_CFLAGS"
	default "-fPIC"
	help
		Define the default compile PIC FLAGS.

endif
```

## arch/arm/aarch64/Kconfig
```kconfig
# SPDX-License-Identifier: Apache-2.0
# Copyright (c) 2019 KapaXL (kapa.xl@outlook.com)

if AARCH64

config CFLAGS
	string "AARCH64_CFLAGS"
	default "-march=armv8-a"
	help
		Define the default compile FLAGS.

config PIC_CFLAGS
	string "AARCH64_PIC_CFLAGS"
	default "-fPIC"
	help
		Define the default compile PIC FLAGS.

config VA_BITS
	int "VA Bits"
	default 39

endif
```

## arch/arm/common/Kconfig
```kconfig
# SPDX-License-Identifier: Apache-2.0
# Copyright (c) 2019 KapaXL (kapa.xl@outlook.com)

if ARM

choice
	prompt "ARM GIC Selection"
	default ARM_GICV2
	help
		choose the GIC version
		By default this option is essential.
config ARM_GICV1
	bool "gic-v1"
	help
		Say Y here to enable gic v1.
config ARM_GICV2
	bool "gic-v2"
	help
		Say Y here to enable gic v2.
config ARM_GICV3
	bool "gic-v3"
	help
		Say Y here to enable gic v3.
endchoice

config ARM_BIGLITTLE
	bool "big.LITTLE"
	default n
	help
		Say Y here to support big.LITTLE.

if ARM_BIGLITTLE
config ARM_CCI
	bool "cci-400/500"
	default n
	help
		Say Y here to enable CCI400/500.
endif

config REE
	bool "REE support"
	default y
	help
		Say Y here to support to trigger the REE(e.g. linux) bootup
		or to resume the REE context in NS mode; CPU only runs
		TEE mode without this support.

config 64BIT
	def_bool n

config MMU
	bool "Enable MMU"
	default USER
	help
		Say Y here to enable the paged virtual memory management.

endif
```

## arch/mips/Kconfig
```kconfig
# SPDX-License-Identifier: Apache-2.0
# Copyright (c) 2019 Xing Loong <xing.xl.loong@gmail.com>

menu "MIPS Architecture"
	depends on MIPS

choice
	prompt "MIPS Selection"
	default MIPS32
config MIPS32
	bool "MIPS32"
config MIPS64
	bool "MIPS64"
	depends on n
	help
		MIPS64 architecture. Not yet implemented - no platform or
		toolchain support exists. Do not select.
endchoice

source "arch/mips/common/Kconfig"

source "arch/mips/mips32/Kconfig"

endmenu
```

## arch/mips/common/Kconfig
```kconfig
# SPDX-License-Identifier: Apache-2.0
# Copyright (c) 2019 KapaXL (kapa.xl@outlook.com)

if MIPS

config 64BIT
	def_bool n

config MMU
	bool "Enable MMU"
	default USER
	help
		Say Y here to enable the paged virtual memory management.

endif
```

## arch/mips/mips32/Kconfig
```kconfig
# SPDX-License-Identifier: Apache-2.0
# Copyright (c) 2019 Xing Loong <xing.xl.loong@gmail.com>

if MIPS32

config FPU
	bool "MIPS32 Hardware FPU (CP1)"
	default y
	help
		Say Y to enable hardware coprocessor 1 (CP1 / FPU) support.
		Select for CPUs with a hardware FPU (e.g. MIPS74Kf).
		Enables Lazy-FPU context save/restore and GPR-only
		compressed exception frames.

config CFLAGS
	string "MIPS32_CFLAGS"
	default "-EL -mips32r2 -G0 -minterlink-mips16 -mcode-readable=pcrel -mno-gpopt"
	help
		Define the default compile FLAGS.

config PIC_CFLAGS
	string "MIPS32_PIC_CFLAGS"
	default "-fPIC -mabicalls"
	help
		Define the default compile PIC FLAGS.

endif
```

## arch/riscv/Kconfig
```kconfig
# SPDX-License-Identifier: Apache-2.0
# Copyright (c) 2022 Xing Loong <xing.xl.loong@gmail.com>

menu "RISCV Architecture"
	depends on RISCV

choice
	prompt "RISCV Selection"
	default RISCV64
config RISCV32
	bool "RISCV32"
config RISCV64
	bool "RISCV64"
	select 64BIT
endchoice

source "arch/riscv/common/Kconfig"

source "arch/riscv/riscv32/Kconfig"

source "arch/riscv/riscv64/Kconfig"

endmenu
```

## arch/riscv/common/Kconfig
```kconfig
# SPDX-License-Identifier: Apache-2.0
# Copyright (c) 2019 KapaXL (kapa.xl@outlook.com)

if RISCV

config RISCV_S_MODE
	bool "S-Mode"
	default USER
	help
		Enables the RISCV S-Mode

config MMU
	bool "Enable MMU"
	default USER
	select RISCV_S_MODE
	help
		Say Y here to enable the paged virtual memory management.

config RISCV_TIMER
	bool
	depends on RISCV_S_MODE
	default y
	help
		Enables the per-hart RISCV timer

config CLINT_TIMER
	bool
	depends on !RISCV_S_MODE
	default y
	help
		Enables the CLINT timer. CLINT timer
		usually used on	M-Mode RISCV systems.

config REE
	bool "REE present"
	default n
	help
		Say Y here to cowork with REE.

config 64BIT
	def_bool n

endif
```

## arch/riscv/riscv32/Kconfig
```kconfig
# SPDX-License-Identifier: Apache-2.0
# Copyright (c) 2019 KapaXL (kapa.xl@outlook.com)

if RISCV32

config MMU_SV32
	bool "sv32 mmu"
	depends on MMU
	help
		Enables the SV32 MMU

config CFLAGS
	string "RISCV32_CFLAGS"
	default "-mabi=ilp32d -march=rv32imafdc_zicsr_zifencei_zicbom -mstrict-align -mcmodel=medany -mno-riscv-attribute"
	help
		Define the default compile FLAGS.

config PIC_CFLAGS
	string "RISCV32_PIC_CFLAGS"
	default "-fPIC"
	help
		Define the default compile PIC FLAGS.

endif
```

## arch/riscv/riscv64/Kconfig
```kconfig
# SPDX-License-Identifier: Apache-2.0
# Copyright (c) 2019 KapaXL (kapa.xl@outlook.com)

if RISCV64

config MMU_SV39
	bool "sv39 mmu"
	depends on MMU
	help
		Enables the SV39 MMU.

config CFLAGS
	string "RISCV64_CFLAGS"
	default "-mabi=lp64d -march=rv64imafdc_zicsr_zifencei_zicbom -mstrict-align -mcmodel=medany -mno-riscv-attribute"
	help
		Define the default compile FLAGS.

config PIC_CFLAGS
	string "RISCV64_PIC_CFLAGS"
	default "-fPIC"
	help
		Define the default compile PIC FLAGS.

config VA_BITS
	int "VA Bits"
	default 39

endif
```

## configs/qemu_andes_ae350_riscv64_imsic_with_ree_defconfig
```kconfig
CONFIG_RISCV=y
CONFIG_REE=y
CONFIG_64BIT=y
CONFIG_MMU=y
CONFIG_CFLAGS="-mabi=lp64d -march=rv64imafdc_zicsr_zifencei_zicbom -mstrict-align -mcmodel=medany -mno-riscv-attribute"
CONFIG_PIC_CFLAGS="-fPIC"
CONFIG_VA_BITS=39
CONFIG_RISCV64=y
CONFIG_RISCV_S_MODE=y
CONFIG_MMU_SV39=y
CONFIG_QEMU_ANDES_AE350_RISCV64_IMSIC=y
CONFIG_NR_CPUS=4
CONFIG_PRINTK=y
CONFIG_TRACE_LEVEL=3
CONFIG_VMALLOC=y
CONFIG_STACK_PROTECTOR=y
CONFIG_BACKTRACE=y
CONFIG_EMBEDDED_DTB=y
CONFIG_OS_ADDR=0xFFFFFFE000000000
CONFIG_KMALLOC_SLAB=y
CONFIG_ELF_LOADER=y
CONFIG_IPC_PIPE=y
CONFIG_IPC_SEM=y
CONFIG_IPC_EVENTFD=y
CONFIG_IPC_SHM=y
CONFIG_IPC_MSGQ=y
CONFIG_DRIVER_BASE=y
CONFIG_RNG=y
CONFIG_PRNG=y
CONFIG_INTC=y
CONFIG_RISCV_APLIC=y
CONFIG_RISCV_IMSIC=y
CONFIG_UART=y
CONFIG_UART_16550=y
CONFIG_TIMER=y
CONFIG_RISCV_TIMER=y
CONFIG_RPC=y
CONFIG_RPC_YIELD=y
CONFIG_RPC_MAX_SESSIONS=100
CONFIG_OTP=y
CONFIG_GLOBALPLATFORM=y
CONFIG_FS=y
CONFIG_POLL=y
CONFIG_EPOLL=y
CONFIG_DEVFS=y
CONFIG_FATFS=y
CONFIG_RAMFS=y
CONFIG_TMPFS=y
CONFIG_DEBUGFS=y
CONFIG_REEFS=y
CONFIG_USER_MBEDCRYPTO=y
CONFIG_KERNEL_MBEDCRYPTO=y
CONFIG_MBEDCRYPTO_CHACHA20=y
CONFIG_MBEDCRYPTO_SHA3=y
CONFIG_MBEDCRYPTO_SM3=y
CONFIG_MBEDCRYPTO_SM4=y
CONFIG_MBEDCRYPTO_SM4_TTABLE=y
CONFIG_MBEDCRYPTO_SM2=y
CONFIG_MBEDCRYPTO_PBKDF2=y
CONFIG_MBEDCRYPTO_CURVE25519=y
CONFIG_MBEDCRYPTO_ED25519_BTABLE=y
CONFIG_MBEDCRYPTO_CURVE448=y
CONFIG_MBEDCRYPTO_DES_TABLE=y
CONFIG_MBEDCRYPTO_AES_SIV=y
CONFIG_USER=y
CONFIG_SYSCALL=y
CONFIG_SPAWN=y
CONFIG_WAITPID=y
CONFIG_USER_PTHREAD=y
CONFIG_SIGNAL=y
CONFIG_USER_BACKTRACE=y
CONFIG_ASLR=y
CONFIG_TEE_API=y
CONFIG_AUTH_TA=y
CONFIG_SIMPLE_SHELL=y
CONFIG_USER_SHELL=y
CONFIG_MBEDTEST=y
CONFIG_MBEDTEST_CRYPTO=y
```

## configs/qemu_ast2700_defconfig
```kconfig
CONFIG_AARCH64=y
CONFIG_ARM_GICV3=y
CONFIG_REE=y
CONFIG_QEMU_AST2700=y
CONFIG_NR_CPUS=4
CONFIG_PRINTK=y
CONFIG_BACKTRACE=y
CONFIG_INTC=y
CONFIG_ASPEED_AST2700_INTC=y
CONFIG_UART=y
CONFIG_UART_16550=y
CONFIG_RPC=y
CONFIG_GLOBALPLATFORM=y
CONFIG_FATFS=y
CONFIG_RAMFS=y
CONFIG_REEFS=y
CONFIG_TMPFS=y
CONFIG_DEBUGFS=y
CONFIG_USER=y
CONFIG_IPC_SHM=y
CONFIG_IPC_MSGQ=y
CONFIG_USER_BACKTRACE=y
CONFIG_EPOLL=y
CONFIG_ASLR=y
CONFIG_TEE_API=y
CONFIG_AUTH_TA=y
CONFIG_SIMPLE_SHELL=y
CONFIG_MBEDTEST=y
```

## configs/qemu_imx7d_defconfig
```kconfig
CONFIG_ARM_GICV2=y
CONFIG_REE=y
CONFIG_QEMU_IMX7D=y
CONFIG_NR_CPUS=2
CONFIG_PRINTK=y
CONFIG_BACKTRACE=y
CONFIG_UART=y
CONFIG_UART_POLL=y
CONFIG_UART_IMX=y
CONFIG_RPC=y
CONFIG_GLOBALPLATFORM=y
CONFIG_FATFS=y
CONFIG_RAMFS=y
CONFIG_REEFS=y
CONFIG_TMPFS=y
CONFIG_DEBUGFS=y
CONFIG_USER=y
CONFIG_IPC_SHM=y
CONFIG_IPC_MSGQ=y
CONFIG_USER_BACKTRACE=y
CONFIG_EPOLL=y
CONFIG_ASLR=y
CONFIG_TEE_API=y
CONFIG_AUTH_TA=y
CONFIG_SIMPLE_SHELL=y
CONFIG_MBEDTEST=y
```

## configs/qemu_malta_mips32r2_defconfig
```kconfig
# CONFIG_ARM is not set
CONFIG_MIPS=y
# CONFIG_RISCV is not set

#
# MIPS Architecture
#
CONFIG_MIPS32=y
# CONFIG_MIPS64 is not set
CONFIG_MMU=y
CONFIG_CFLAGS="-EL -mips32r2 -G 0 -mno-mips16 -mno-interlink-mips16 -msoft-float -mxgot -mcode-readable=no"
CONFIG_PIC_CFLAGS="-mabicalls -fPIC"
# end of MIPS Architecture

#
# Platform Configure
#
CONFIG_QEMU_MALTA_MIPS32R2=y
# CONFIG_SALIX_MIPS74K is not set
# end of Platform Configure

#
# General Setup
#
CONFIG_NR_CPUS=1
CONFIG_PRINTK=y
CONFIG_VMALLOC=y
CONFIG_STACK_PROTECTOR=y
CONFIG_BACKTRACE=y
CONFIG_EMBEDDED_DTB=y
CONFIG_ELF_LOADER=y
CONFIG_OS_ADDR=0x80100000
# end of General Setup

#
# Device Drivers
#
CONFIG_DRIVER_BASE=y
CONFIG_RNG=y
CONFIG_PRNG=y
CONFIG_INTC=y
CONFIG_INTEL_I8259=y
# CONFIG_SALIX_MIPS_INTC is not set
CONFIG_UART=y
CONFIG_UART_16550=y
# CONFIG_UART_PL011 is not set
# CONFIG_UART_SIFIVE is not set
# CONFIG_RPC is not set
# CONFIG_GLOBALPLATFORM is not set
# end of Device Drivers

#
# File Systems
#
CONFIG_FS=y
CONFIG_DEVFS=y
CONFIG_FATFS=y
CONFIG_RAMFS=y
CONFIG_TMPFS=y
CONFIG_DEBUGFS=y
# end of File Systems

#
# Libraries
#
CONFIG_KERN_NEWLIB=y
CONFIG_FDT_LIB=y
CONFIG_USER_MBEDTLS=y
# CONFIG_USER_MBEDTLS_PSA is not set
# CONFIG_USER_MBEDTLS_X509 is not set
# CONFIG_USER_MBEDTLS_SSL is not set
CONFIG_KERNEL_MBEDTLS=y
# end of Libraries

#
# UserSpace
#
CONFIG_USER=y
CONFIG_SYSCALL=y
CONFIG_USER_PTHREAD=y
CONFIG_SIGNAL=y
CONFIG_IPC_SHM=y
CONFIG_IPC_MSGQ=y
CONFIG_USER_BACKTRACE=y
CONFIG_EPOLL=y
CONFIG_ASLR=y
CONFIG_TEE_API=y
# end of UserSpace

#
# Applications
#
CONFIG_AUTH_TA=y
CONFIG_SIMPLE_SHELL=y
CONFIG_USER_SHELL=y
# CONFIG_KERN_SHELL is not set
# end of Applications
```

## configs/qemu_microblaze_v_riscv32_S_defconfig
```kconfig
CONFIG_RISCV=y
CONFIG_CFLAGS="-mabi=ilp32f -march=rv32imafc_zicsr_zifencei_zicbom -mstrict-align -mcmodel=medany -mno-riscv-attribute"
CONFIG_MMU_SV32=y
CONFIG_QEMU_MICROBLAZE_V_RISCV32=y
CONFIG_NR_CPUS=1
CONFIG_PRINTK=y
CONFIG_BACKTRACE=y
CONFIG_INTC=y
CONFIG_XLNX_INTC=y
CONFIG_UART=y
CONFIG_UART_POLL=y
CONFIG_UART_16550=y
CONFIG_XLNX_TIMER=y
CONFIG_FATFS=y
CONFIG_RAMFS=y
CONFIG_TMPFS=y
CONFIG_DEBUGFS=y
CONFIG_USER=y
CONFIG_IPC_SHM=y
CONFIG_IPC_MSGQ=y
CONFIG_USER_BACKTRACE=y
CONFIG_EPOLL=y
CONFIG_ASLR=y
CONFIG_TEE_API=y
CONFIG_AUTH_TA=y
CONFIG_SIMPLE_SHELL=y
CONFIG_MBEDTEST=y
```

## configs/qemu_microblaze_v_riscv32_defconfig
```kconfig
CONFIG_RISCV=y
CONFIG_CFLAGS="-mabi=ilp32f -march=rv32imafc_zicsr_zifencei_zicbom -mstrict-align -mcmodel=medany -mno-riscv-attribute"
CONFIG_PIC_CFLAGS="-fPIC"
CONFIG_RISCV32=y
CONFIG_QEMU_MICROBLAZE_V_RISCV32=y
CONFIG_NR_CPUS=1
CONFIG_PRINTK=y
CONFIG_TRACE_LEVEL=3
CONFIG_STACK_PROTECTOR=y
CONFIG_BACKTRACE=y
CONFIG_EMBEDDED_DTB=y
CONFIG_OS_ADDR=0x80000000
CONFIG_KMALLOC_SLAB=y
CONFIG_IPC_PIPE=y
CONFIG_IPC_EVENTFD=y
CONFIG_DRIVER_BASE=y
CONFIG_RNG=y
CONFIG_PRNG=y
CONFIG_INTC=y
CONFIG_XLNX_INTC=y
CONFIG_UART=y
CONFIG_UART_POLL=y
CONFIG_UART_16550=y
CONFIG_TIMER=y
CONFIG_XLNX_TIMER=y
CONFIG_OTP=y
CONFIG_FS=y
CONFIG_POLL=y
CONFIG_DEVFS=y
CONFIG_FATFS=y
CONFIG_RAMFS=y
CONFIG_RAMFS_SIZE=64
CONFIG_TMPFS=y
CONFIG_DEBUGFS=y
CONFIG_KERNEL_MBEDCRYPTO=y
CONFIG_SIMPLE_SHELL=y
CONFIG_KERN_SHELL=y
```

## configs/qemu_microblaze_v_riscv64_defconfig
```kconfig
CONFIG_RISCV=y
CONFIG_RISCV64=y
CONFIG_CFLAGS="-mabi=lp64f -march=rv64imafc_zicsr_zifencei_zicbom -mstrict-align -mcmodel=medany -mno-riscv-attribute"
CONFIG_QEMU_MICROBLAZE_V_RISCV64=y
CONFIG_NR_CPUS=1
CONFIG_PRINTK=y
CONFIG_BACKTRACE=y
CONFIG_INTC=y
CONFIG_XLNX_INTC=y
CONFIG_UART=y
CONFIG_UART_POLL=y
CONFIG_UART_16550=y
CONFIG_XLNX_TIMER=y
CONFIG_FATFS=y
CONFIG_RAMFS=y
CONFIG_TMPFS=y
CONFIG_DEBUGFS=y
CONFIG_SIMPLE_SHELL=y
```

## configs/qemu_virt_riscv32_defconfig
```kconfig
CONFIG_RISCV=y
CONFIG_MMU_SV32=y
CONFIG_NR_CPUS=4
CONFIG_PRINTK=y
CONFIG_BACKTRACE=y
CONFIG_INTC=y
CONFIG_RISCV_PLIC=y
CONFIG_UART=y
CONFIG_UART_POLL=y
CONFIG_UART_16550=y
CONFIG_RISCV_TIMER=y
CONFIG_RPC=y
CONFIG_GLOBALPLATFORM=y
CONFIG_FATFS=y
CONFIG_RAMFS=y
CONFIG_TMPFS=y
CONFIG_DEBUGFS=y
CONFIG_USER=y
CONFIG_IPC_SHM=y
CONFIG_IPC_MSGQ=y
CONFIG_USER_BACKTRACE=y
CONFIG_EPOLL=y
CONFIG_ASLR=y
CONFIG_TEE_API=y
CONFIG_AUTH_TA=y
CONFIG_SIMPLE_SHELL=y
CONFIG_MBEDTEST=y
```
